## conf/bblayers.conf.sample
```bitbake
CONF_VERSION = "1"

BBPATH = "${TOPDIR}"
BBFILES ?= ""
METADIR := "${@os.path.abspath(os.path.dirname(d.getVar('FILE')) + '/../..')}"

BBLAYERS ?= " \
    ##OEROOT##/meta \
    ##OEROOT##/meta-poky \
    ${METADIR}/meta-openembedded/meta-python \
    ${METADIR}/meta-openembedded/meta-filesystems \
    ${METADIR}/meta-openembedded/meta-multimedia \
    ${METADIR}/meta-openembedded/meta-networking \
    ${METADIR}/meta-openembedded/meta-oe \
    ${METADIR}/meta-openembedded/meta-webserver \
    ${METADIR}/meta-automate-home \
"

BBLAYERS_NON_REMOVABLE ?= " \
    ##OEROOT##/meta \
"
```

## conf/distro/automate-home.conf
```bitbake
require conf/distro/poky.conf

DISTRO = "automate-home"
DISTRO_NAME = "The brain device for your smart home"
DISTRO_VERSION = "1.0.0"
DISTRO_CODENAME = "first"

SDK_VENDOR = "-homebrain_sdk"
SDK_NAME = \
    "${DISTRO}-${TCLIBC}-${SDK_ARCH}-${IMAGE_BASENAME}-${TUNE_PKGARCH}"
SDK_VERSION := \
    "${@'${DISTRO_VERSION}'.replace('snapshot-${DATE}','snapshot')}"

MAINTAINER = "Maja Massarini <maja.massarini@gmail.com>"

SMART_HOME_LOCALE ?= "en_US.UTF-8"

WARN_QA_remove = "license-checksum"
ERROR_QA_remove = "license-checksum"
```

## conf/layer.conf
```bitbake
# We have a conf and classes directory, append to BBPATH
BBPATH .= ":${LAYERDIR}"

# We have a recipes directory, add to BBFILES
BBFILES += "${LAYERDIR}/recipes*/*/*.bb ${LAYERDIR}/recipes*/*/*.bbappend ${LAYERDIR}/recipes*/*/*/*.bbappend"

BBFILE_COLLECTIONS += "meta-automate-home"
BBFILE_PATTERN_meta-automate-home := "^${LAYERDIR}/"
BBFILE_PRIORITY_meta-automate-home = "11"

LAYERVERSION_meta-automate-home = "1"
LAYERDEPENDS_meta-automate-home = "core openembedded-layer"
LAYERSERIES_COMPAT_meta-homino = "zeus dunfell"
```
